## boards/shields/woposh/Kconfig.defconfig
```kconfig
if SHIELD_WOPOSH_LEFT

config ZMK_KEYBOARD_NAME
    default "woposh"

config ZMK_SPLIT_ROLE_CENTRAL
    default y

endif # SHIELD_WOPOSH_LEFT

if SHIELD_WOPOSH_LEFT || SHIELD_WOPOSH_RIGHT

config ZMK_SPLIT
    default y

endif # SHIELD_WOPOSH_LEFT || SHIELD_WOPOSH_RIGHT
```

## boards/shields/woposh/Kconfig.shield
```kconfig
config SHIELD_WOPOSH_LEFT
    def_bool $(shields_list_contains,woposh_left)

config SHIELD_WOPOSH_RIGHT
    def_bool $(shields_list_contains,woposh_right)
```
